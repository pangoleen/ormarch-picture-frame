## image/uboot/src/pf1007l_linux_defconfig
```kconfig
CONFIG_ARM=y
CONFIG_ARCH_SUNXI=y
CONFIG_DEFAULT_DEVICE_TREE="sun8i-a33-pf1007l-linux"
CONFIG_SPL=y
CONFIG_MACH_SUN8I_A33=y
CONFIG_DRAM_CLK=456
CONFIG_DRAM_ZQ=31739
# CONFIG_VIDEO_SUNXI is not set
# CONFIG_SYS_MALLOC_CLEAR_ON_INIT is not set
CONFIG_CONS_INDEX=1
CONFIG_SUNXI_CONSOLE_NO_PINMUX=y
CONFIG_AXP_DCDC1_VOLT=3300
CONFIG_AXP_DCDC2_VOLT=1200
CONFIG_AXP_ALDO1_VOLT=3300
CONFIG_BOOTDELAY=-2
CONFIG_USE_BOOTCOMMAND=y
CONFIG_BOOTCOMMAND="setenv stdin nulldev; if load mmc 0:1 ${scriptaddr} /boot.scr; then source ${scriptaddr}; fi; while true; do ums 0 mmc 0; sleep 3; done"
CONFIG_SYS_CONSOLE_IS_IN_ENV=y
CONFIG_SYS_DEVICE_NULLDEV=y
CONFIG_ENV_IS_NOWHERE=y
# CONFIG_ENV_IS_IN_FAT is not set
CONFIG_USB_MUSB_GADGET=y
CONFIG_CMD_USB_MASS_STORAGE=y
CONFIG_CMD_UMS_NO_ABORT=y
CONFIG_CRC32_VERIFY=y
```
